## conf/layer.conf
```bitbake
# We have a conf and classes directory, append to BBPATH
BBPATH .= ":${LAYERDIR}"

# We have a recipes directory, add to BBFILES
BBFILES += " \
	${LAYERDIR}/rzg/*/*.bb \
	${LAYERDIR}/rzg/*/*.bbappend \
"


BBFILE_COLLECTIONS += "rzg-demos"
BBFILE_PATTERN_rzg-demos := "^${LAYERDIR}/"
BBFILE_PRIORITY_rzg-demos = "7"
```

## meta-rzg1/common/conf/layer.conf
```bitbake
# We have a conf and classes directory, append to BBPATH
BBPATH .= ":${LAYERDIR}:${LAYERDIR}/recipes-images/"

# We have a recipes directory, add to BBFILES
BBFILES += " \
	${LAYERDIR}/recipes-*/*.bb \
	${LAYERDIR}/recipes-*/*.bbappend \
	${LAYERDIR}/recipes-*/*/*.bb \
	${LAYERDIR}/recipes-*/*/*.bbappend \
"


BBFILE_COLLECTIONS += "common-layer"
BBFILE_PATTERN_common-layer := "^${LAYERDIR}/"
BBFILE_PRIORITY_common-layer = "7"
```

## meta-rzg1/doorphone/conf/layer.conf
```bitbake
# We have a conf and classes directory, append to BBPATH
BBPATH .= ":${LAYERDIR}"

# We have a recipes directory, add to BBFILES
BBFILES += " \
	${LAYERDIR}/recipes-*/*/*.bb \
	${LAYERDIR}/recipes-*/*/*.bbappend \
	${LAYERDIR}/recipes-*/*.bb \
	${LAYERDIR}/recipes-*/*.bbappend \
"


BBFILE_COLLECTIONS += "doorphone-demo"
BBFILE_PATTERN_doorphone-demo := "^${LAYERDIR}/"
BBFILE_PRIORITY_doorphone-demo = "7"
```

## meta-rzg1/qt-hmi-demo/qt-framework/conf/layer.conf
```bitbake
# We have a conf and classes directory, append to BBPATH
BBPATH .= ":${LAYERDIR}"

# We have a recipes directory, add to BBFILES
BBFILES += " \
	${LAYERDIR}/recipes-*/*/*.bb \
	${LAYERDIR}/recipes-*/*/*.bbappend \
	${LAYERDIR}/recipes-*/*.bb \
	${LAYERDIR}/recipes-*/*.bbappend \
"


BBFILE_COLLECTIONS += "qt-framework"
BBFILE_PATTERN_qt-framework := "^${LAYERDIR}/"
BBFILE_PRIORITY_qt-framework = "7"
```

## meta_rzg1/common/conf/layer.conf
```bitbake
# We have a conf and classes directory, append to BBPATH
BBPATH .= ":${LAYERDIR}"

# We have a recipes directory, add to BBFILES
BBFILES += " \
	${LAYERDIR}/recipes-*/*.bb \
	${LAYERDIR}/recipes-*/*.bbappend \
	${LAYERDIR}/recipes-*/*/*.bb \
	${LAYERDIR}/recipes-*/*/*.bbappend \
"


BBFILE_COLLECTIONS += "common-layer"
BBFILE_PATTERN_common-layer := "^${LAYERDIR}/"
BBFILE_PRIORITY_common-layer = "7"
```

## meta_rzg1/hmi_demo/conf/layer.conf
```bitbake
# We have a conf and classes directory, append to BBPATH
BBPATH .= ":${LAYERDIR}"

# We have a recipes directory, add to BBFILES
BBFILES += " \
	${LAYERDIR}/recipes-*/*.bb \
	${LAYERDIR}/recipes-*/*.bbappend \
	${LAYERDIR}/recipes-multimedia/*/*.bb \
	${LAYERDIR}/recipes-multimedia/*/*.bbappend \
"


BBFILE_COLLECTIONS += "multimedia-demos"
BBFILE_PATTERN_multimedia-demos := "^${LAYERDIR}/"
BBFILE_PRIORITY_multimedia-demos = "7"
```
